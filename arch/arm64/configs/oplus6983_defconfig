## drivers/input/oplus_secure_common/Kconfig
```kconfig
### secure common config
config OPLUS_SECURE_COMMON
       default n
       tristate "Secure common"
```

## drivers/soc/Kconfig
```kconfig
# SPDX-License-Identifier: GPL-2.0-only
menu "SOC (System On Chip) specific Drivers"

source "drivers/soc/actions/Kconfig"
source "drivers/soc/amlogic/Kconfig"
source "drivers/soc/aspeed/Kconfig"
source "drivers/soc/atmel/Kconfig"
source "drivers/soc/bcm/Kconfig"
source "drivers/soc/fsl/Kconfig"
source "drivers/soc/imx/Kconfig"
source "drivers/soc/ixp4xx/Kconfig"
source "drivers/soc/mediatek/Kconfig"
source "drivers/soc/qcom/Kconfig"
source "drivers/soc/renesas/Kconfig"
source "drivers/soc/rockchip/Kconfig"
source "drivers/soc/samsung/Kconfig"
source "drivers/soc/sifive/Kconfig"
source "drivers/soc/sunxi/Kconfig"
source "drivers/soc/tegra/Kconfig"
source "drivers/soc/ti/Kconfig"
source "drivers/soc/ux500/Kconfig"
source "drivers/soc/versatile/Kconfig"
source "drivers/soc/xilinx/Kconfig"
source "drivers/soc/zte/Kconfig"
source "drivers/soc/kendryte/Kconfig"

#ifdef OPLUS_BUG_STABILITY
source "drivers/soc/oplus/system/Kconfig"
#endif /* OPLUS_BUG_STABILITY */

#ifdef OPLUS_BOOT_FEATURE
source "drivers/soc/oplus/boot/Kconfig"
#endif /* OPLUS_BOOT_FEATURE */

#ifdef OPLUS_DFT_FEATURE
source "drivers/soc/oplus/dft/Kconfig"
#endif /* OPLUS_DFT_FEATURE */

#ifdef OPLUS_TP_BASIC
source "drivers/soc/oplus/device_info/Kconfig"
#endif /*#ifdef OPLUS_TP_BASIC*/

#ifdef OPLUS_FEATURE_MM_FEEDBACK
source "drivers/soc/oplus/oplus_mm_fb/Kconfig"
#endif /* OPLUS_FEATURE_MM_FEEDBACK */

endmenu
```
